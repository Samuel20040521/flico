// SSD1306 128x32 driver. The init sequence below is the standard
// recipe from the Solomon Systech datasheet for 128x32 panels with the
// charge pump enabled.

#include "ssd1306.hpp"
#include <cstring>


// ---------------------------------------------------------------------------
// 8x8 font — public-domain font8x8_basic (Daniel Hepper, CC0). Each entry is
// eight bytes, one per row (top to bottom). Bit 0 (LSB) is the LEFTMOST
// pixel of the row, bit 7 is the rightmost. Covers printable ASCII 0x20..0x7E.
// ---------------------------------------------------------------------------
static const uint8_t FONT8X8[96][8] = {
    { 0x00, 0x00, 0x00, 0x00, 0x00, 0x00, 0x00, 0x00 }, // ' '
    { 0x18, 0x3C, 0x3C, 0x18, 0x18, 0x00, 0x18, 0x00 }, // '!'
    { 0x36, 0x36, 0x00, 0x00, 0x00, 0x00, 0x00, 0x00 }, // '"'
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    { 0x6E, 0x3B, 0x00, 0x00, 0x00, 0x00, 0x00, 0x00 }, // '~'
};


// ---------------------------------------------------------------------------
// I2C wire helpers. The SSD1306 control byte (first I2C payload byte) tells
// it whether the rest of the transaction is commands (0x00) or display data
// (0x40).
// ---------------------------------------------------------------------------
void SSD1306::cmd(uint8_t c) {
    uint8_t buf[2] = { 0x00, c };
    i2c_write_blocking(i2c_, addr_, buf, 2, false);
}

void SSD1306::cmd2(uint8_t c0, uint8_t c1) {
    uint8_t buf[3] = { 0x00, c0, c1 };
    i2c_write_blocking(i2c_, addr_, buf, 3, false);
}

void SSD1306::cmd3(uint8_t c0, uint8_t c1, uint8_t c2) {
    uint8_t buf[4] = { 0x00, c0, c1, c2 };
    i2c_write_blocking(i2c_, addr_, buf, 4, false);
}


// ---------------------------------------------------------------------------
// Standard SSD1306 init for 128x32. Charge-pump enabled so no external Vcc
// is required.
// ---------------------------------------------------------------------------
void SSD1306::init() {
    cmd(0xAE);                  // display off
    cmd2(0xD5, 0x80);           // clock divide ratio / oscillator freq
    cmd2(0xA8, HEIGHT - 1);     // multiplex ratio (0x1F for 32-row)
    cmd2(0xD3, 0x00);           // display offset = 0
    cmd(0x40);                  // start line = 0
    cmd2(0x8D, 0x14);           // enable charge pump
    cmd2(0x20, 0x00);           // horizontal addressing mode
    cmd(0xA1);                  // segment remap col 127 -> SEG0
    cmd(0xC8);                  // COM scan COM[N-1] -> COM0
    cmd2(0xDA, 0x02);           // COM pins config (0x02 for 128x32)
    cmd2(0x81, 0x8F);           // contrast
    cmd2(0xD9, 0xF1);           // pre-charge period
    cmd2(0xDB, 0x40);           // VCOMH deselect
    cmd(0xA4);                  // display follows RAM
    cmd(0xA6);                  // non-inverted
    cmd(0xAF);                  // display on

    fill(false);
    show();
}


void SSD1306::show() {
    cmd3(0x21, 0, WIDTH - 1);   // column address range
    cmd3(0x22, 0, PAGES - 1);   // page address range

    // Burst the whole framebuffer out. Prepend the 0x40 control byte so the
    // panel knows the rest of the payload is GDDRAM data, not commands.
    uint8_t payload[1 + BUF_LEN];
    payload[0] = 0x40;
    std::memcpy(payload + 1, buf_, BUF_LEN);
    i2c_write_blocking(i2c_, addr_, payload, sizeof(payload), false);
}


// ---------------------------------------------------------------------------
// Framebuffer primitives. The buffer layout is MONO_VLSB: byte at
// (page*WIDTH + col) is a vertical 8-pixel strip, bit 0 = topmost row of
// that page. This matches the SSD1306's GDDRAM layout exactly so show() is
// a straight DMA-style memcpy.
// ---------------------------------------------------------------------------
void SSD1306::fill(bool on) {
    std::memset(buf_, on ? 0xFF : 0x00, BUF_LEN);
}

void SSD1306::pixel(int x, int y, bool on) {
    if ((unsigned)x >= WIDTH || (unsigned)y >= HEIGHT) return;
    int page = y >> 3;
    int bit  = y & 7;
    int idx  = page * WIDTH + x;
    if (on) buf_[idx] |=  (uint8_t)(1 << bit);
    else    buf_[idx] &= (uint8_t)~(1 << bit);
}

void SSD1306::fill_rect(int x, int y, int w, int h, bool on) {
    int x_end = x + w;
    int y_end = y + h;
    if (x < 0) x = 0;
    if (y < 0) y = 0;
    if (x_end > WIDTH)  x_end = WIDTH;
    if (y_end > HEIGHT) y_end = HEIGHT;
    for (int yy = y; yy < y_end; ++yy) {
        for (int xx = x; xx < x_end; ++xx) {
            pixel(xx, yy, on);
        }
    }
}


void SSD1306::text(const char* s, int x, int y, int scale, bool on) {
    if (scale < 1) scale = 1;
    int cx = x;
    while (*s) {
        char ch = *s++;
        if (ch >= 0x20 && ch <= 0x7E) {
            const uint8_t* glyph = FONT8X8[ch - 0x20];
            for (int row = 0; row < 8; ++row) {
                uint8_t bits = glyph[row];
                if (!bits) continue;
                for (int col = 0; col < 8; ++col) {
                    if (bits & (1 << col)) {
                        if (scale == 1) {
                            pixel(cx + col, y + row, on);
                        } else {
                            fill_rect(cx + col * scale,
                                      y + row * scale,
                                      scale, scale, on);
                        }
                    }
                }
            }
        }
        cx += 8 * scale;
        if (cx >= WIDTH) break;
    }
}
